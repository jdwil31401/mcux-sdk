## west.yml
```yaml
manifest:
  remotes:
  - name: nxpmicro
    url-base: https://github.com/NXPmicro
  defaults:
    remote: nxpmicro
  projects:
  - name: mcux-sdk-examples
    revision: 5cd7a6e753e0f28fe1a895189cb51c9607e37a49
    path: examples
    url: ssh://git@bitbucket.sw.nxp.com/mcucore/mcux-sdk-examples-github.git
  - name: FreeRTOS-Kernel
    revision: 247fceb185f9bb65ade9a9c2e849522807b4b3f9
    path: rtos/freertos/freertos_kernel
    url: ssh://git@bitbucket.sw.nxp.com/mcucore/freertos-kernel.git
  - name: mcux-sdk-middleware-sdmmc
    revision: 92d79a983ee23bcb1a17bca151eb6c2030964cf0
    path: middleware/sdmmc
    url: ssh://git@bitbucket.sw.nxp.com/mcucore/mcux-sdk-sdmmc.git
  - name: mcux-sdk-middleware-multicore
    path: middleware/multicore
    revision: 49963441f277fdbbc6a9e1d8763785473742b855
    url: ssh://git@bitbucket.sw.nxp.com/mcucore/mcux-sdk-multicore.git
  - name: rpmsg-lite
    path: middleware/multicore/rpmsg_lite
    url: https://github.com/NXPmicro/rpmsg-lite
    revision: f12ffe998a9b52f0327e109b5b3005a2ef787770
  - name: erpc
    path: middleware/multicore/erpc
    url: https://github.com/EmbeddedRPC/erpc
    revision: 6a571caf6d5042af5d63ff8745f2e4b24e14bc9f
  - name: lwip
    path: middleware/lwip
    revision: 79f3c7930cfc744f85523704363349b38b81f433
    url: ssh://git@bitbucket.sw.nxp.com/mcucore/lwip.git
  - name: mbedtls
    path: middleware/mbedtls
    revision: 75010b7b49c72067f4c3e57361975069075bca74
    url: ssh://git@bitbucket.sw.nxp.com/mcucore/mcux-sdk-mbedtls.git
  - name: wifi_nxp
    path: middleware/wifi
    revision: b1e9cc126ec820a22cdb59da8b1fa37980e8cf66
    url: ssh://git@bitbucket.sw.nxp.com/mcucore/mcux-sdk-wifi-nxp.git
  self:
    path: core
```
